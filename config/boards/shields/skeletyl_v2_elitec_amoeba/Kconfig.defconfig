## config/boards/shields/skeletyl_v2_elitec_amoeba/Kconfig.defconfig
```kconfig
# Copyright (c) 2022 ZMK Contributors
# SPDX-License-Identifier: MIT
 
 
if SHIELD_SKELETYL_LEFT

config ZMK_KEYBOARD_NAME
	default "Skeletyl_l"

endif

if SHIELD_SKELETYL_RIGHT

config ZMK_KEYBOARD_NAME
	default "Skeletyl_r"

endif

if SHIELD_SKELETYL_DONGLE

config ZMK_KEYBOARD_NAME
	default "Skeletyl_d"

config ZMK_SPLIT_BLE_ROLE_CENTRAL
	default y

config ZMK_SPLIT_ROLE_CENTRAL
    default y

config ZMK_SPLIT
    default y

config ZMK_SPLIT_BLE_CENTRAL_PERIPHERALS
    default 2

config BT_MAX_CONN
    default 6

config BT_MAX_PAIRED
    default 6

endif

if SHIELD_SKELETYL_LEFT || SHIELD_SKELETYL_RIGHT || SHIELD_SKELETYL_DONGLE

config ZMK_SPLIT
	default y

endif
```

## config/boards/shields/skeletyl_v2_elitec_amoeba/Kconfig.shield
```kconfig
# Copyright (c) 2020 ZMK Contributors
# SPDX-License-Identifier: MIT

config SHIELD_SKELETYL_LEFT
	def_bool $(shields_list_contains,skeletyl_v2_elitec_amoeba_left)

config SHIELD_SKELETYL_RIGHT
	def_bool $(shields_list_contains,skeletyl_v2_elitec_amoeba_right)

config SHIELD_SKELETYL_DONGLE
	def_bool $(shields_list_contains,skeletyl_v2_elitec_amoeba_dongle)
```
